## sdkconfig.defaults
```kconfig
# LVGL 字体：App 层 UI 示例需要
CONFIG_LV_FONT_MONTSERRAT_14=y
CONFIG_LV_FONT_MONTSERRAT_16=y
CONFIG_LV_FONT_MONTSERRAT_24=y
CONFIG_LV_FONT_SOURCE_HAN_SANS_SC_16_CJK=y

# --- PSRAM: 8MB Octal ---
CONFIG_SPIRAM=y
CONFIG_SPIRAM_MODE_OCT=y
CONFIG_SPIRAM_TYPE_AUTO=y
CONFIG_SPIRAM_CLK_IO=30
CONFIG_SPIRAM_CS_IO=26
CONFIG_SPIRAM_SPEED_80M=y
CONFIG_SPIRAM_BOOT_HW_INIT=y
CONFIG_SPIRAM_BOOT_INIT=y
# 用 USE_MALLOC（另一台正常机器同款）：PSRAM 以 DMA 可访问方式注册进堆，
# i80 DMA 才能从 PSRAM 显存读数据（USE_CAPS_ALLOC 时 i80 读 PSRAM 黑屏）
CONFIG_SPIRAM_USE_MALLOC=y
CONFIG_SPIRAM_MEMTEST=y
CONFIG_SPIRAM_MALLOC_ALWAYSINTERNAL=16384
CONFIG_SPIRAM_MALLOC_RESERVE_INTERNAL=32768

# --- 分区表：自定义（含 storage/SPIFFS 分区，见 partitions.csv）---
CONFIG_PARTITION_TABLE_CUSTOM=y
CONFIG_PARTITION_TABLE_CUSTOM_FILENAME="partitions.csv"

# --- FPS 显示：LVGL 性能监视器（屏幕角落显示 FPS + CPU 占用）---
# CONFIG_LV_USE_SYSMON=y
# CONFIG_LV_USE_PERF_MONITOR=y
# CONFIG_LV_PERF_MONITOR_ALIGN_BOTTOM_RIGHT=y
```
